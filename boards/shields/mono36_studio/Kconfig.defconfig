## boards/shields/mono36_studio/Kconfig.defconfig
```kconfig
# Copyright (c) 2023 The ZMK Contributors
# SPDX-License-Identifier: MIT

if SHIELD_MONO36_STUDIO

config ZMK_KEYBOARD_NAME
    default "MONO36_STUDIO"

config ZMK_SPLIT
    default y

config ZMK_BLE
    default y

endif
```

## boards/shields/mono36_studio/Kconfig.shield
```kconfig
# Copyright (c) 2023 The ZMK Contributors
# SPDX-License-Identifier: MIT

config SHIELD_MONO36_STUDIO
    def_bool $(shields_list_contains,mono36)
```
